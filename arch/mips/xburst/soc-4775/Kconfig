## arch/mips/xburst/soc-4775/Kconfig
```kconfig
choice
	prompt "Board type"
	depends on SOC_4775
	default BOARD_4775_TEST

config BOARD_4775_ORION
        bool "ORION"

config BOARD_4775_MENSA
        bool "MENSA"

endchoice

config BOARD_NAME
	string
	default "orion" if BOARD_4775_ORION
	default "mensa" if BOARD_4775_MENSA
```

## drivers/misc/jz_cim/Kconfig
```kconfig
config JZ_CIM
	bool "ingenic camera interface module"
	depends on MACH_XBURST
	default y

config OV3640
	bool "ov3640 camera sensor"
	depends on JZ_CIM
	default n

config OV7675
	bool "ov7675 camera sensor"
	depends on JZ_CIM
	default n

config OV2650
	bool "ov2650 camera sensor"
	depends on JZ_CIM
	default n

config OV2659_MODULE
	bool "ov2659 camera sensor module"
	depends on JZ_CIM
	default n

config OV5640
	bool "ov5640 camera sensor module"
	depends on JZ_CIM
	default n

config SP0838
	bool "sp0838 camera sensor"
	depends on JZ_CIM
	default n

config GC0308
	bool "gc0308 camera sensor"
	depends on JZ_CIM
	default n

config HORIZONTAL_MIRROR
	bool "camera sensor horizontal mirror"
	depends on JZ_CIM
	default n

config VERTICAL_MIRROR
	bool "camera sensor vertical mirror"
	depends on JZ_CIM
	default n

config GC0308_Q8
	bool "double_gc0308_q8 camera sensor"
	depends on JZ_CIM
	default n



config GC2015
	bool "gc2015 camera sensor"
	depends on JZ_CIM
	default n
config HI253
	bool "hi253 camera sensor"
	depends on JZ_CIM
	default n

config HI704
	bool "hi704 camera sensor"
	depends on JZ_CIM
	default n

config FAKE
	bool "fake camera sensor only for test"
	depends on JZ_CIM
	default n

config FAKE_NR
	int "fake camera sensor number"
	depends on FAKE
	default 2

config GT2005
        bool "gt2005 camera sensor"
        depends on JZ_CIM
        default n
```

## drivers/nand/Kconfig
```kconfig
#
# NAND subsystem configuration
# drivers/nand/Kconfig
#

menuconfig NAND
	tristate "NAND support"
	depends on HAS_IOMEM
	help
          This enables support for NAND flash
	  If you want NAND support, you should say Y here and also to the
	  specific driver for your bus adapter(s) below.


if NAND

config NAND_JZ4780
	bool "Support NAND Flash device on JZ4780"
        depends on (SOC_4780 || SOC_4775) && NAND
        default y

choice
        prompt "select real or fake nand driver for test"
        depends on NAND_JZ4780
        default REAL_NAND_DRIVER 

config  REAL_NAND_DRIVER
        bool 'use real nand driver test'
        help
          use real nand driver test nand.

config  FAKE_NAND_DRIVER
        bool 'use fake nand driver test'
        help
          use fake nand driver test nand.

endchoice

config NEMC_SRAM_8BIT
	bool "Support JZ4780 8bit sram setting"
	depends on NAND_JZ4780_FUNCTION && NAND_COMMON
	default n
        help
	  If you want set JZ4780 sram function. This selects default is y.

config NAND_JZ4780_FUNCTION
	bool "Support JZ4780 function setting"
        depends on NAND_JZ4780 && !MMC0_JZ4780_PA_4BIT && !MMC0_JZ4780_PA_8BIT &&  !MMC0_JZ4780_PA_4BIT_RESET && ! MMC0_JZ4780_PA_8BIT_RESET
        select NAND_COMMON
        default y
        help
	  This selects the NAND function for JZ4780 support. 
          If you have an JZ4780 platform with a NAND slot,
          say Y here.

	  If unsure, say N.
          NOTE: If GPIOA is selected by MSC0, Nand function
          Setting will be hiding.

config NAND_COMMON
	bool "NAND_COMMON"
	depends on NAND_JZ4780_FUNCTION
        help
	  If you want set NAND function. This selects default 
          is y.

config NAND_CS1
	bool "NAND_CS1"
        depends on NAND_JZ4780_FUNCTION
        default y
config NAND_CS2
	bool "NAND_CS2"
        depends on NAND_JZ4780_FUNCTION

config NAND_CS3
	bool "NAND_CS3"
        depends on NAND_JZ4780_FUNCTION

config NAND_CS4
	bool "NAND_CS4"
        depends on NAND_JZ4780_FUNCTION

config NAND_CS5
	bool "NAND_CS5"
        depends on NAND_JZ4780_FUNCTION

config NAND_CS6
	bool "NAND_CS6"
        depends on NAND_JZ4780_FUNCTION

choice
        prompt "8 bit or 16 bit NAND bus width"
        depends on NAND_JZ4780
        default NAND_BUS_WIDTH_8

config NAND_BUS_WIDTH_8
        bool '8 bit'
        help
          The bus width of NAND flash is 8 bit.

config  NAND_BUS_WIDTH_16
        bool '16 bit'
        help
          The bus width of NAND flash is 16 bit.

endchoice

choice
        prompt "512 byte or 1024 byte NAND ecc size "
        depends on NAND_JZ4780
        default NAND_BCH_ECCSIZE_1024

config NAND_BCH_ECCSIZE_DEFAULT
        bool 'default'
        help
          The ecc size of NAND flash is default.

config NAND_BCH_ECCSIZE_512
        bool '512 byte'
        help
          The ecc size of NAND flash is 512 byte.

config  NAND_BCH_ECCSIZE_1024
        bool '1024 byte'
        help
          The bus width of NAND flash is 1024 byte.

endchoice

choice
	prompt "ECC type"
        depends on NAND_JZ4780
	default NAND_HW_BCH

config  NAND_SW_BCH
	bool 'Select software BCH'

config	NAND_HW_BCH
	bool 'Select hardware BCH'

endchoice

choice
        prompt "4 bit or 8 bit ... 64 bit BCH ecc"
        depends on NAND_JZ4780 && NAND_HW_BCH
        default NAND_HW_BCH_AUTO

config  NAND_HW_BCH_AUTO
        bool 'auto'

config  NAND_HW_BCH_4BIT
        bool '4 bit'

config  NAND_HW_BCH_8BIT
        bool '8 bit'

config  NAND_HW_BCH_12BIT
        bool '12 bit'

config  NAND_HW_BCH_16BIT
        bool '16 bit'

config  NAND_HW_BCH_20BIT
        bool '20 bit'

config  NAND_HW_BCH_24BIT
        bool '24 bit'

config	NAND_HW_BCH_28BIT
	bool '28 bit'

config 	NAND_HW_BCH_32BIT
	bool '32 bit'

config	NAND_HW_BCH_36BIT
	bool '36 bit'

config	NAND_HW_BCH_40BIT
	bool '40 bit'

config	NAND_HW_BCH_44BIT
	bool '44 bit'

config	NAND_HW_BCH_48BIT
	bool '48 bit'

config	NAND_HW_BCH_52BIT
	bool '52 bit'

config	NAND_HW_BCH_56BIT
	bool '56 bit'

config	NAND_HW_BCH_60BIT
	bool '60 bit'

config	NAND_HW_BCH_64BIT
	bool '64 bit'

endchoice

choice
        prompt "The Nand output driver"
        depends on NAND_JZ4780
        default NAND_LOW_DRIVER

config	NAND_LOW_DRIVER
	bool 'low driver'

config	NAND_NORMAL_DRIVER
	bool 'normal driver'

config	NAND_HIGH_DRIVER
	bool 'high driver'

endchoice

config 	NAND_DMA
	depends on NAND_JZ4780 && !FAKE_NAND_DRIVER
	bool 'Use DMA mode'
        default y
	help
	  This enables using DMA for reading and writing NAND flash, if not selected,
          then CPU mode is used.

config 	TOGGLE_NAND
	depends on NAND_JZ4780
	bool 'Use Toggle NAND'
	help
	  This enables that Toggle NAND flash is used, if not selected,
          Connection nand flash is used.

config MUL_PARTS
	depends on NAND_JZ4780
	bool  "Mul Parts"
	default y
endif # NAND
```

## drivers/usb/dwc2/Kconfig
```kconfig
config USB_DWC2
	tristate "DesignWare Core USB 2.0 Hi-Speed On-The-Go(OTG)"
	depends on USB
	help
	  Say Y or M here if your system has a Dual Role SuperSpeed
	  USB controller based on the DesignWare USB2.0 IP Core.

	  If you choose to build this driver is a dynamically linked
	  module, the module will be called dwc2.ko.

if USB_DWC2

choice
	prompt "Driver Mode"
	help
	  Select Driver Mode

config USB_DWC2_DUAL_ROLE
	bool "Both Host and Device"
	help
	  Say Y here to enable both Host and Device function

config USB_DWC2_HOST_ONLY
	bool "Host Mode Only"
	help
	  Say Y here to enable Host function only

config USB_DWC2_DEVICE_ONLY
	bool "Device Mode Only"
	help
	  Say Y Here to enable Device function only

endchoice

config BOARD_HAS_NO_DETE_FACILITY
       bool "board has no plug detect facility"
       default n
       help
         Say Y here if your board has no plug detect facility

config USB_DWC2_DEBUG
	bool "Enable Debugging(dev_dbg) Messages"
	help
	  Say Y here to enable debugging messages on DWC2 Driver.

config USB_DWC2_VERBOSE
	bool "Enable Verbose Debugging(dev_vdbg) Messages"
	depends on USB_DWC2_DEBUG
	help
	  Say Y here to enable verbose debugging messages on DWC2 Driver.

config USB_DWC2_VERBOSE_VERBOSE
	bool "Enable Very Verbose Debugging Messagers"
	default y
	help
	  enable debugging messages for developer debug, these debugging messages
          are switchable write 1 to file under /sys/module/dwc2/parameters/,
          the default value is 0, so you can always say Y here and won't get boring.

config USB_DWC2_HOST_TRACER
	bool "Enable tracing host operation flow"
	help
	  Say Y here to enable tracing host operation flow,
	  you must reserve 192M~256M memory

endif
```

## sound/oss/jzsound/Kconfig
```kconfig
menuconfig SOUND_OSS_XBURST
	bool "Open Sound System of xburst"
	#depends on SOUND_OSS_CORE
	default y
	help
	  Say 'Y' to enable Open Sound System drivers of xburst.


if SOUND_OSS_XBURST
#*******************************************************
config SOUND_I2S_JZ47XX
	bool "Jz On-Chip I2S driver"
	help
		Say 'Y' to enable On-Chip i2s

if SOUND_I2S_JZ47XX

config CODEC_STANDBY
depends on JZ_EXTERNAL_CODEC || JZ_INTERNAL_CODEC
bool "codec standby"
help
	Say "Y" to enable codec standby function

menuconfig JZ_INTERNAL_CODEC

	bool "xburst internal coedc"
	depends on SOUND_I2S_JZ47XX
	help
		Say "Y" to select xburst internal codec.

if JZ_INTERNAL_CODEC

	config JZ4780_INTERNAL_CODEC
	bool "jz4780 internal codec"
	depends on SOC_4780
	help
		Say "Y" to enable jz4780 internal codec.

	config JZ4775_INTERNAL_CODEC
	bool "jz4775 internal codec"
	depends on SOC_4775
	help
		Say "Y" to enable jz4775 internal codec.
endif #JZ_INTERNAL_CODEC

menuconfig JZ_EXTERNAL_CODEC
	bool "xburst external codec"
	help
		Say	"Y" to setect xburst external codec		\
		Note :it is will be unused when internal codec select

if JZ_EXTERNAL_CODEC #external codec

	config ATC2603_EXTERNAL_CODEC
	depends on SPI
	bool "atc2603 external codec"
	help
		Say "Y" to enable atc260x codec

endif #JZ_EXTERNAL_CODEC

endif #SOUND_I2S_JZ47XX
#******************************************************
config SOUND_PCM_JZ47XX
	bool "Jz On-Chip PCM driver"
	help
		Say 'Y' to enable On-Chip pcm
if SOUND_PCM_JZ47XX
menu "sound pcm codec list"
endmenu
endif #SOUND_PCM_JZ47XX

menuconfig SOUND_XBURST_DETECT
	bool "sound detect device of xburst"
	default n
	help
	  Say 'Y' to enable sound detect devices support.

if SOUND_XBURST_DETECT

menu "JZ headset detect"

config JZ_HP_DETECT_CODEC
	bool "jz4780 headphone codec detect"
	depends on SOUND_I2S_JZ47XX || SOUND_PCM_JZ47XX
	help
	Say "Y" to enable codec headphone detect.

config JZ_HP_DETECT_GPIO
	bool "jz4780 headphone gpio detect"
	help
	Say "Y" to enable gpio headphone detect.
endmenu #"JZ headset detect"

#menu "JZ dock detect"

#endmenu

endif #SOUND_XBURST_DETECT

#menuconfig SOUND_XBURST_DEBUG
#	bool "sound debug device of xburst"
#	default n
#	help
#	  Say 'Y' to enable sound debug devices support.
#
endif #SOUND_OSS_XBURST
```
